## examples/esp-idf/17_simple_video_server/sdkconfig.defaults.esp32p4
```kconfig
CONFIG_CAMERA_SC2336=y
CONFIG_IDF_EXPERIMENTAL_FEATURES=y

# Keep the P4 bootloader within the default 0x8000 partition-table boundary.
CONFIG_BOOTLOADER_LOG_LEVEL_WARN=y
CONFIG_BOOTLOADER_LOG_LEVEL=2

CONFIG_SPIRAM=y
CONFIG_SPIRAM_SPEED_200M=y

CONFIG_ESP_VIDEO_ENABLE_ISP_PIPELINE_CONTROLLER=y

# CONFIG_EXAMPLE_SELECT_ESP32P4_FUNCTION_EV_BOARD_V1_5=y

# ESP32-P4-POE-ETH camera and Ethernet configuration
CONFIG_EXAMPLE_SELECT_CUSTOMIZED_DEV_BOARD=y

CONFIG_EXAMPLE_CONNECT_WIFI=n
CONFIG_EXAMPLE_CONNECT_ETHERNET=y
CONFIG_EXAMPLE_CONNECT_IPV6=n

CONFIG_EXAMPLE_MIPI_CSI_SCCB_I2C_PORT=0
CONFIG_EXAMPLE_MIPI_CSI_SCCB_I2C_SCL_PIN=8
CONFIG_EXAMPLE_MIPI_CSI_SCCB_I2C_SDA_PIN=7
CONFIG_EXAMPLE_MIPI_CSI_CAM_SENSOR_RESET_PIN=-1
CONFIG_EXAMPLE_MIPI_CSI_CAM_SENSOR_PWDN_PIN=-1
CONFIG_EXAMPLE_MIPI_CSI_XCLK_PIN=-1

CONFIG_ESPTOOLPY_FLASHSIZE_32MB=y
```
